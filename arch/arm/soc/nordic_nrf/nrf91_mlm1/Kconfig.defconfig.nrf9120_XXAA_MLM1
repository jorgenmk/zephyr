## arch/arm/soc/nordic_nrf/nrf91_mlm1/Kconfig.defconfig.nrf9120_XXAA_MLM1
```kconfig
# Kconfig.defconfig.nrf9120_XXAA_MLM1 - Nordic Semiconductor nRF9120 MLM1 MCU
#
# Copyright (c) 2018 Nordic Semiconductor ASA
#
# SPDX-License-Identifier: Apache-2.0
#


if SOC_NRF9120_XXAA_MLM1

config SOC
	string
	default "nRF9120_MLM1"

config NUM_IRQS
	int
	default 39

endif # SOC_NRF9120_XXAA_MLM1
```

## arch/arm/soc/nordic_nrf/nrf91_mlm1/Kconfig.defconfig.series
```kconfig
# Kconfig.defconfig.series - Nordic Semiconductor nRF9 MCU line
#
# Copyright (c) 2018 Nordic Semiconductor ASA
#
# SPDX-License-Identifier: Apache-2.0
#

if SOC_SERIES_NRF91X_MLM1

source "arch/arm/soc/nordic_nrf/nrf91_mlm1/Kconfig.defconfig.nrf91*"

config SOC_SERIES
	default "nrf91_mlm1"

config SYS_CLOCK_HW_CYCLES_PER_SEC
	int
	default 32768

config SYS_POWER_MANAGEMENT
	default y

endif # SOC_SERIES_NRF91X_MLM1
```

## arch/arm/soc/nordic_nrf/nrf91_mlm1/Kconfig.series
```kconfig
# Kconfig.series - Nordic Semiconductor nRF9 MCU line
#
# Copyright (c) 2018 Nordic Semiconductor ASA
#
# SPDX-License-Identifier: Apache-2.0
#

config  SOC_SERIES_NRF91X_MLM1
	bool "Nordic Semiconductor nRF91 MLM1 series MCU"
	select CPU_CORTEX_M4
	select CPU_HAS_MPU
	select SOC_FAMILY_NRF
	select NRF_RTC_TIMER
	select CLOCK_CONTROL
	select CLOCK_CONTROL_NRF5
	select SYS_POWER_LOW_POWER_STATE_SUPPORTED
	select SYS_POWER_DEEP_SLEEP_SUPPORTED
	select XIP
	select HAS_CMSIS
	select HAS_NRFX
	help
	 Enable support for NRF91 MLM1 MCU series
```

## arch/arm/soc/nordic_nrf/nrf91_mlm1/Kconfig.soc
```kconfig
# Kconfig.soc - Nordic Semiconductor nRF91 MCU line
#
# Copyright (c) 2018 Nordic Semiconductor ASA
#
# SPDX-License-Identifier: Apache-2.0
#

config SOC_NRF9120_MLM1
	depends on SOC_SERIES_NRF91X
	bool
	select CPU_CORTEX_M4
	select CPU_HAS_MPU
	select SOC_FAMILY_NRF
	select NRF_RTC_TIMER
	select CLOCK_CONTROL
	select CLOCK_CONTROL_NRF5
	select SYS_POWER_LOW_POWER_STATE_SUPPORTED
	select SYS_POWER_DEEP_SLEEP_SUPPORTED
	select XIP
	select HAS_CMSIS
	select HAS_NRFX

choice
prompt "nRF91x MCU Selection"
depends on SOC_SERIES_NRF91X

config SOC_NRF9120_XXAA_MLM1
	bool "NRF9120_MLM1"
	select SOC_NRF9120_MLM1

endchoice

config ARM_MPU_NRF91X
	bool "Enable MPU on nRF91"
	depends on CPU_HAS_MPU
	select ARM_MPU
	default n
	help
	  Enable MPU support on Nordic Semiconductor nRF91x series ICs.
```

## boards/arm/nrf9120_mlm1_pca10074/Kconfig.board
```kconfig
# Kconfig - nRF91 MLM1 PCA10074 board configuration
#
# Copyright (c) 2018 Nordic Semiconductor ASA
#
# SPDX-License-Identifier: Apache-2.0

config  BOARD_NRF9120_MLM1_PCA10074
	bool "nRF9120_MLM1_PCA10074"
	depends on SOC_NRF9120_XXAA_MLM1
```

## boards/arm/nrf9120_mlm1_pca10074/Kconfig.defconfig
```kconfig
# Kconfig - nRF91 MLM1 PCA10074 board configuration
#
# Copyright (c) 2018 Nordic Semiconductor ASA
#
# SPDX-License-Identifier: Apache-2.0

if BOARD_NRF9120_MLM1_PCA10074

config BOARD
	default "nrf9120_mlm1_pca10074"

if UART_NRFX

config UART_0_NRF_TX_PIN
	default 4

config UART_0_NRF_RX_PIN
	default 6

config UART_0_NRF_RTS_PIN
	default 3

config UART_0_NRF_CTS_PIN
	default 5

endif # UART_NRF5

endif # BOARD_NRF9120_MLM1_PCA10074
```

## boards/arm/nrf9120_mlm1_pca10074/nrf9120_mlm1_pca10074_defconfig
```kconfig
CONFIG_ARM=y
CONFIG_SOC_FAMILY_NRF=y
CONFIG_SOC_SERIES_NRF91X=y
CONFIG_SOC_NRF9120_XXAA_MLM1=y
CONFIG_BOARD_NRF9120_MLM1_PCA10074=y

# Enable MPU
CONFIG_ARM_MPU_NRF91X=y

# Enable uart driver
CONFIG_SERIAL=y
CONFIG_UART_NRFX=y
CONFIG_UART_0_NRF_UARTE=y

# enable console
CONFIG_CONSOLE=y
CONFIG_UART_CONSOLE=y

# additional board options
# CONFIG_GPIO_AS_PINRESET=y
```

## soc/arm/nordic_nrf/nrf91_mlm1/Kconfig.soc
```kconfig
# Kconfig.soc - Nordic Semiconductor nRF91 MCU line
#
# Copyright (c) 2018 Nordic Semiconductor ASA
#
# SPDX-License-Identifier: Apache-2.0
#

config SOC_NRF9120_MLM1
	depends on SOC_SERIES_NRF91X_MLM1
	bool
	select CPU_HAS_FPU
	select HAS_HW_NRF_CLOCK
	select HAS_HW_NRF_EGU0
	select HAS_HW_NRF_GPIO0
	select HAS_HW_NRF_GPIOTE
	select HAS_HW_NRF_I2S
	select HAS_HW_NRF_MWU
	select HAS_HW_NRF_POWER
	select HAS_HW_NRF_PWM0
	select HAS_HW_NRF_QDEC
	select HAS_HW_NRF_RTC0
	select HAS_HW_NRF_SWI0
	select HAS_HW_NRF_TIMER0
	select HAS_HW_NRF_TIMER1
	select HAS_HW_NRF_TIMER2
	select HAS_HW_NRF_TWIM1
	select HAS_HW_NRF_TWIS1
	select HAS_HW_NRF_SPIM1
	select HAS_HW_NRF_UARTE0
	select HAS_HW_NRF_WDT

choice
prompt "nRF91x MCU Selection"
depends on SOC_SERIES_NRF91X_MLM1

config SOC_NRF9120_XXAA_MLM1
	bool "NRF9120_MLM1"
	select SOC_NRF9120_MLM1

endchoice

config ARM_MPU_NRF91X
	bool "Enable MPU on nRF91"
	depends on CPU_HAS_MPU
	select ARM_MPU
	default n
	help
	  Enable MPU support on Nordic Semiconductor nRF91x series ICs.
```

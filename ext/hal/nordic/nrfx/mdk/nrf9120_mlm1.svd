# nrf9120_MLM1 register map
Vendor: Nordic Semiconductor; Series: nrf91; File version: 1
nrf9120_MLM1 reference description for radio MCU with ARM 32-bit Cortex-M4 Microcontroller
CPU: CM4 r0p1, little endian, MPU, FPU, 3 interrupt priority bits
Registers are 32-bit, read-write, reset 0x0 unless marked. A register's access mark holds for its fields unless they carry their own. Offsets are from the block's base; lines under a group give offsets from that group; [hi:lo] are bit positions; {n}, {i} and the like mark numbered series; 'fields as' and 'values as' point back to an identical list; <NAME> marks a mode.

## Memory map
0x00FF0000 FICR size 0x1000 — Factory Information Configuration Registers
0x00FF8000 UICR size 0x1000 — User Information Configuration Registers
0x40000000 PMU_REGULATORS size 0x1000
0x40000000 PMU_OSCILLATORS size 0x1000
0x40000000 RADIOLTE size 0x1000 — LTE-M Radio
0x40000000 AMLI size 0x1000 — AHB Multi-Layer Interface
0x40000000 DCNF size 0x1000 — Domain Configuration Management
0x40001000 MWU size 0x1000 — Memory Watch Unit
0x40003000 REGULATORS size 0x1000 — Voltage Regulators control
0x40003000 OSCILLATORS size 0x1000 — Oscillators control
0x40005000 CLOCK size 0x1000 — Clock Management
0x40005000 POWER size 0x1000 — Power Control
0x40007000 PAMLI size 0x1000 — Peripheral AHB Multi-Layer Interface
0x40008000 UARTE0 size 0x1000 — UART with EasyDMA 0
0x40008000 SPIM0 size 0x1000 — Serial Peripheral Interface Master with EasyDMA 0
0x40008000 SPIS0 size 0x1000 — SPI Slave 0
0x40008000 TWIM0 size 0x1000 — I2C compatible Two-Wire Master Interface with EasyDMA 0
0x40008000 TWIS0 size 0x1000 — I2C compatible Two-Wire Slave Interface with EasyDMA 0
0x40009000 UARTE1 size 0x1000 — UART with EasyDMA 1
0x40009000 SPIM1 size 0x1000 — Serial Peripheral Interface Master with EasyDMA 1
0x40009000 SPIS1 size 0x1000 — SPI Slave 1
0x40009000 TWIM1 size 0x1000 — I2C compatible Two-Wire Master Interface with EasyDMA 1
0x40009000 TWIS1 size 0x1000 — I2C compatible Two-Wire Slave Interface with EasyDMA 1
0x4000A000 GPIOTE size 0x1000 — GPIO Tasks and Events
0x4000B000 SAADC size 0x1000 — Analog to Digital Converter
0x4000C000 TIMER0 size 0x1000 — Timer/Counter 0
0x4000D000 TIMER1 size 0x1000 — Timer/Counter 1
0x4000E000 TIMER2 size 0x1000 — Timer/Counter 2
0x4000F000 RTC0 size 0x1000 — Real time counter 0
0x40010000 DPPIC size 0x1000 — Distributed Programmable Peripheral Interconnect Controller
0x40011000 NFCT size 0x1000 — NFC-A compatible radio
0x40012000 WDT size 0x1000 — Watchdog Timer
0x40013000 QDEC size 0x1000 — Quadrature Decoder
0x40014000 COMP size 0x1000 — Comparator
0x40014000 LPCOMP size 0x1000 — Low Power Comparator
0x40015000 SWI0 size 0x1000 — Software interrupt
0x40015000 EGU0 size 0x1000 — Event Generator Unit
0x40016000 PWM0 size 0x1000 — Pulse Width Modulation Unit
0x40017000 PDM size 0x1000 — Pulse Density Modulation (Digital Microphone) Interface
0x40018000 I2S size 0x1000 — Inter-IC Sound
0x40019000 IPC size 0x1000 — Inter Processor Communication
0x4001A000 EXTFLASH size 0x1000 — External Flash interface
0x4001B000 RTC1 size 0x1000 — Real time counter 1
0x4001F000 USBD size 0x1000 — Universal Serial Bus device
0x40030000 NVMC size 0x1000 — Non Volatile Memory Controller
0x40031000 VMC size 0x1000 — Volatile Memory controller
0x40800000 GPIO size 0x1000 — GPIO Port
0xE0080000 TAD size 0x1000 — Trace and debug control

## Interrupts
1 MWU
5 CLOCK_POWER (CLOCK, POWER)
8 UARTE0_SPIM0_SPIS0_TWIM0_TWIS0 (UARTE0, SPIM0, SPIS0, TWIM0, TWIS0)
9 UARTE1_SPIM1_SPIS1_TWIM1_TWIS1 (UARTE1, SPIM1, SPIS1, TWIM1, TWIS1)
10 GPIOTE
11 SAADC
12 TIMER0
13 TIMER1
14 TIMER2
15 RTC0
17 NFCT
18 WDT
19 QDEC
20 COMP_LPCOMP (COMP, LPCOMP)
21 SWI0_EGU0 (SWI0, EGU0)
22 PWM0
23 PDM
24 I2S
25 IPC
26 EXTFLASH
27 RTC1
31 USBD

## Further device data
ExampleStackSize=2048, ExampleHeapSize=2048, MaxInterrupts=240

## Licence text in the file
Copyright (c) 2016, Nordic Semiconductor ASA. All rights reserved. . Redistribution and use in source and binary forms, with or without modification, are permitted provided that the following conditions are met: * Redistributions of source code must retain the above copyright notice, this list of conditions and the following disclaimer. * Redistributions in binary form must reproduce the above copyright notice, this list of conditions and the following disclaimer in the documentation and/or other materials provided with the distribution. * Neither the name of Nordic Semiconductor ASA nor the names of its contributors may be used to endorse or promote products derived from this software without specific prior written permission. . THIS SOFTWARE IS PROVIDED BY THE COPYRIGHT HOLDERS AND CONTRIBUTORS "AS IS" AND ANY EXPRESS OR IMPLIED WARRANTIES, INCLUDING, BUT NOT LIMITED TO, THE. IMPLIED WARRANTIES OF MERCHANTABILITY AND FITNESS FOR A PARTICULAR PURPOSE ARE. DISCLAIMED. IN NO EVENT SHALL THE COPYRIGHT HOLDER OR CONTRIBUTORS BE LIABLE. FOR ANY DIRECT, INDIRECT, INCIDENTAL, SPECIAL, EXEMPLARY, OR CONSEQUENTIAL. DAMAGES (INCLUDING, BUT NOT LIMITED TO, PROCUREMENT OF SUBSTITUTE GOODS OR. SERVICES; LOSS OF USE, DATA, OR PROFITS; OR BUSINESS INTERRUPTION) HOWEVER. CAUSED AND ON ANY THEORY OF LIABILITY, WHETHER IN CONTRACT, STRICT LIABILITY, OR TORT (INCLUDING NEGLIGENCE OR OTHERWISE) ARISING IN ANY WAY OUT OF THE USE. OF THIS SOFTWARE, EVEN IF ADVISED OF THE POSSIBILITY OF SUCH DAMAGE.
